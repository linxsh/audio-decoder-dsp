## Kconfig
```kconfig
# Author: linxsh
#
# Kconfig: Top Level Kconfig
#
#---------------------------------------------------------------------------------#

mainmenu "Configuration"

choice
	prompt "Platform Select:"
	default X86

	config X86
		bool "x86"

	config DSP32
		bool "dsp32"
endchoice

#----------------------------------------------------------------------------------#
menu "Version Setting:"

config VERSION
	string "version"
	default 1.0.0

endmenu

#----------------------------------------------------------------------------------#
menu "Decoder Select:"

config VORBIS_DECODER
	bool "vorbis"
	default y

config OPUS_DECODER
	bool "opus"
	default y

endmenu

#----------------------------------------------------------------------------------#
menu "Encoder Select:"

config VORBIS_ENCODER
	bool "vorbis"
	default y

config OPUS_ENCODER
	bool "opus"
	default y

endmenu
```
